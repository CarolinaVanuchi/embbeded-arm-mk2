## main/Kconfig.projbuild
```kconfig
menu "Entradas e saidas"
        
    config GPIO_RXD
        int "RXD PORT"
        range 1 39
        default 16
        help
            RXD port.
                    
    config GPIO_TXD
        int "TXD PORT"
        range 1 39
        default 17
        help
            TXD port.

    config GPIO_LED
        int "LED do robo"
        range 1 39
        default 2
        help
            LED do robo.
     
    config GPIO_MICRO_SERVO
        int "Micro servo digital input"
        range 1 39
        default 18
        help
            Micro servo digital input.

    config GPIO_END_BASE
        int "Fim de curso para a base input"
        range 1 39
        default 27
        help
            Fim de curso para a base.

    config GPIO_END_MOTOR_LEFT
        int "Fim de curso para o elo esquerdo"
        range 1 39
        default 15
        help
            Fim de curso para o elo esquerdo.

    config GPIO_END_MOTOR_DIREITO
        int "Fim de curso para o elo direito"
        range 1 39
        default 4
        help
            Fim de curso para o elo direito.

    config GPIO_MOTOR_BASE_ENABLE
        int "Motor da base enable"
        range 1 39
        default 19
        help
            Motor da base enable.
            
    config GPIO_MOTOR_BASE
        int "Motor da base"
        range 1 39
        default 13
        help
            Motor da base.

    config GPIO_MOTOR_BASE_DIRECAO
        int "Sentido do motor da base"
        range 1 39
        default 14
        help
            Sentido do motor da base.


    config GPIO_MOTOR_LEFT_ENABLE
        int "Motor esquerdo enable"
        range 1 39
        default 32
        help
            Motor esquerdo enable.
            
    config GPIO_MOTOR_LEFT
        int "Motor esquerdo"
        range 1 39
        default 33
        help
            Motor esquerdo.

    config GPIO_MOTOR_LEFT_DIRECAO
        int "Sentido do motor esquerdo"
        range 1 39
        default 25
        help
            Sentido do motor esquerdo.

    config GPIO_MOTOR_DIREITO_ENABLE
        int "Motor direito enable"
        range 1 39
        default 23
        help
            Motor direito enable.
            
    config GPIO_MOTOR_DIREITO
        int "Motor direito"
        range 1 39
        default 21
        help
            Motor direito.

    config GPIO_MOTOR_DIREITO_DIRECAO
        int "Sentido do motor direito"
        range 1 39
        default 22
        help
            Sentido do motor direito.

endmenu
```
